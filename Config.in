## configs/stm32f767_defconfig
```kconfig
BR2_arm=y
BR2_cortex_m7=y
BR2_DL_DIR="$(TOPDIR)/../dl"
BR2_HOST_DIR="$(TOPDIR)/../host"
BR2_GLOBAL_PATCH_DIR="$(BR2_EXTERNAL_STM32F767_PATH)/patches"
BR2_KERNEL_HEADERS_4_14=y
BR2_TOOLCHAIN_BUILDROOT_CXX=y
BR2_PACKAGE_HOST_ELF2FLT=y
BR2_LINUX_KERNEL=y
BR2_LINUX_KERNEL_CUSTOM_VERSION=y
BR2_LINUX_KERNEL_CUSTOM_VERSION_VALUE="4.15.7"
BR2_LINUX_KERNEL_USE_CUSTOM_CONFIG=y
BR2_LINUX_KERNEL_CUSTOM_CONFIG_FILE="$(BR2_EXTERNAL_STM32F767_PATH)/configs/linux"
BR2_LINUX_KERNEL_DTS_SUPPORT=y
BR2_LINUX_KERNEL_DTB_IS_SELF_BUILT=y
BR2_ROOTFS_POST_IMAGE_SCRIPT="$(BR2_EXTERNAL_STM32F767_PATH)/post-image.sh"
BR2_LINUX_KERNEL_INTREE_DTS_NAME="stm32f746-disco"
BR2_PACKAGE_BUSYBOX_CONFIG="$(BR2_EXTERNAL_STM32F767_PATH)/configs/busybox"
BR2_PACKAGE_BUSYBOX_SHOW_OTHERS=y
BR2_PACKAGE_SDL=y
BR2_PACKAGE_SDL_TTF=y
BR2_PACKAGE_LIBPTHREAD_STUBS=y
BR2_TARGET_ROOTFS_EXT2=y
BR2_TARGET_ROOTFS_INITRAMFS=y
# BR2_TARGET_ROOTFS_TAR is not set
```

## configs/stm32f767l_defconfig
```kconfig
BR2_arm=y
BR2_cortex_m7=y
BR2_DL_DIR="$(BR2_EXTERNAL_STM32F7H7_PATH)/downloads"
BR2_GLOBAL_PATCH_DIR="$(BR2_EXTERNAL_STM32F7H7_PATH)/stm32f767l/patches"
BR2_KERNEL_HEADERS_VERSION=y
BR2_DEFAULT_KERNEL_VERSION="5.6.16"
BR2_PACKAGE_HOST_LINUX_HEADERS_CUSTOM_5_6=y
# BR2_UCLIBC_INSTALL_UTILS is not set
BR2_GCC_VERSION_11_X=y
BR2_TOOLCHAIN_BUILDROOT_CXX=y
BR2_TARGET_GENERIC_HOSTNAME="Module_v1.00"
BR2_TARGET_GENERIC_ISSUE="Welcome to Linux/STM32F7-Series"
BR2_ROOTFS_DEVICE_CREATION_STATIC=y
BR2_TARGET_GENERIC_ROOT_PASSWD="nova"
# BR2_TARGET_GENERIC_REMOUNT_ROOTFS_RW is not set
# BR2_ENABLE_LOCALE_PURGE is not set
BR2_ROOTFS_OVERLAY="$(BR2_EXTERNAL_STM32F7H7_PATH)/stm32f767l/overlay"
BR2_ROOTFS_POST_IMAGE_SCRIPT="$(BR2_EXTERNAL_STM32F7H7_PATH)/scripts/post-image.sh"
BR2_LINUX_KERNEL=y
BR2_LINUX_KERNEL_CUSTOM_VERSION=y
BR2_LINUX_KERNEL_CUSTOM_VERSION_VALUE="5.6.16"
BR2_LINUX_KERNEL_USE_CUSTOM_CONFIG=y
BR2_LINUX_KERNEL_CUSTOM_CONFIG_FILE="$(BR2_EXTERNAL_STM32F7H7_PATH)/stm32f767l/kernel.config"
BR2_LINUX_KERNEL_DTS_SUPPORT=y
BR2_LINUX_KERNEL_INTREE_DTS_NAME="stm32f746-disco"
BR2_PACKAGE_BUSYBOX_CONFIG="$(BR2_EXTERNAL_STM32F7H7_PATH)/stm32f767l/busybox.config"
BR2_PACKAGE_FLASHBENCH=y
BR2_PACKAGE_MEMTESTER=y
BR2_PACKAGE_LZO=y
BR2_PACKAGE_ZLIB=y
# BR2_PACKAGE_IFUPDOWN_SCRIPTS is not set
BR2_TARGET_ROOTFS_AXFS=y
BR2_TARGET_ROOTFS_CRAMFS=y
BR2_TARGET_ROOTFS_CRAMFS_XIP=y
BR2_TARGET_ROOTFS_EXT2=y
BR2_TARGET_ROOTFS_EXT2_SIZE="4M"
BR2_TARGET_ROOTFS_JFFS2=y
BR2_TARGET_ROOTFS_JFFS2_CUSTOM=y
BR2_TARGET_ROOTFS_JFFS2_CUSTOM_EBSIZE=0x10000
BR2_TARGET_ROOTFS_JFFS2_PAD=y
BR2_TARGET_ROOTFS_JFFS2_PADSIZE=0x400000
BR2_TARGET_ROOTFS_JFFS2_USE_CUSTOM_PAGESIZE=y
BR2_TARGET_ROOTFS_JFFS2_CUSTOM_PAGESIZE=0x100
BR2_TARGET_ROOTFS_SQUASHFS=y
BR2_TARGET_ROOTFS_SQUASHFS4_LZO=y
# BR2_TARGET_ROOTFS_TAR is not set
BR2_TARGET_ROOTFS_UBI=y
BR2_TARGET_ROOTFS_UBI_PEBSIZE=0x10000
BR2_TARGET_ROOTFS_UBI_SUBSIZE=256
BR2_TARGET_ROOTFS_UBIFS_LEBSIZE=0x10000
BR2_TARGET_UBOOT=y
BR2_TARGET_UBOOT_BUILD_SYSTEM_KCONFIG=y
BR2_TARGET_UBOOT_CUSTOM_VERSION=y
BR2_TARGET_UBOOT_CUSTOM_VERSION_VALUE="2021.10"
BR2_TARGET_UBOOT_USE_CUSTOM_CONFIG=y
BR2_TARGET_UBOOT_CUSTOM_CONFIG_FILE="$(BR2_EXTERNAL_STM32F7H7_PATH)/stm32f767l/uboot.config"
BR2_PACKAGE_HOST_BTRFS_PROGS=y
BR2_PACKAGE_HOST_F2FS_TOOLS=y
BR2_PACKAGE_HOST_UBOOT_TOOLS=y
BR2_PACKAGE_HELLO=y
```
